// SPDX-License-Identifier: GPL-2.0-only
/*
 * Raven Device Tree
 *
 * Copyright 2021-2023 Google LLC
 * Copyright 2023-2025 Linaro Ltd
 */

/dts-v1/;

#include "gs101-pixel-common.dtsi"

/ {
	model = "Raven";
	compatible = "google,gs101-raven", "google,gs101";
};

&cont_splash_mem {
	reg = <0x0 0xfac00000 (1440 * 3120 * 4)>;
	status = "okay";
};

&framebuffer0 {
	width = <1440>;
	height = <3120>;
	stride = <(1440 * 4)>;
	format = "a8r8g8b8";
	status = "okay";
};

&spitouch {
	compatible = "samsung,s6sy761";
	/* sec,panel_map = <&samsung_s6e3hc3 0>; */
	sec,touch_offload_id = /bits/ 8 <'0' '0' 'r' '4'>;
	sec,mm2px = /bits/ 8 <20>;
	sec,encoded_enable = <1>;
	sec,fod_coords = <720 2361>;
};
